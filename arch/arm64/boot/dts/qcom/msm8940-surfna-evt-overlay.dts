/* Copyright (c) 2018, Motorola Mobility Inc. All rights reserved.
 *
 * This program is free software; you can redistribute it and/or modify
 * it under the terms of the GNU General Public License version 2 and
 * only version 2 as published by the Free Software Foundation.
 *
 * This program is distributed in the hope that it will be useful,
 * but WITHOUT ANY WARRANTY; without even the implied warranty of
 * MERCHANTABILITY or FITNESS FOR A PARTICULAR PURPOSE.  See the
 * GNU General Public License for more details.
 */

/dts-v1/;
/plugin/;

#include <dt-bindings/clock/qcom,gcc-sdm429w.h>
#include <dt-bindings/clock/qcom,rpmcc.h>
#include <dt-bindings/clock/mdss-28nm-pll-clk-legacy.h>
#include <dt-bindings/clock/qcom,cpu-sdm.h>
#include "msm8940-surfna-common-overlay.dtsi"

/ {
	model = "surfna";
	qcom,msm-id = <313 0x0>;
	qcom,board-id = <0x48 0x8000>, <0x49 0x8000>;
};
